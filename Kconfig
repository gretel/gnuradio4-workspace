## Kconfig
```kconfig
# SPDX-License-Identifier: MIT
mainmenu "GNU Radio 4 Configuration"

menu "Core SDK"
config ENABLE_GR4_CORE
    bool "gnuradio4-core (runtime, scheduler, blocklib, meta)"
    default y
    select ENABLE_GR4_ALGORITHM
    select ENABLE_GR4_BLOCKS
    help
        GNU Radio 4.0 core: runtime, scheduler, lock-free buffers, block
        development framework, blocklib generator, meta-type system, and
        plugin infrastructure.

config ENABLE_GR4_ALGORITHM
    bool "gnuradio4-algorithm (DSP / algorithm library)"
    depends on ENABLE_GR4_CORE
    default y
    help
        Reusable non-block DSP and algorithm libraries split out of GNU Radio 4.
        Builds against gnuradio4-core SDK. Installs CMake package 'gnuradio4Algorithm'.

config ENABLE_GR4_BLOCKS
    bool "gnuradio4-blocks (standard MIT-licensed block library)"
    depends on ENABLE_GR4_ALGORITHM
    default y
    help
        Standard MIT-licensed GNU Radio 4 block libraries (audio, SDR, debug,
        math, misc, etc.). Builds against installed gnuradio4-core and
        gnuradio4Algorithm SDKs.
endmenu

menu "Extensions"
config ENABLE_GR4_INCUBATOR
    bool "gr4-incubator (IIO, SoapySDR, PFB, audio)"
    depends on ENABLE_GR4_CORE
    select ENABLE_HTTP
    help
        Staging area for GR4 block development: IIO (PlutoSDR/FISH Ball),
        SoapySDR blocks, polyphase filterbank, and experimental audio blocks.
        Blocks are upstreamed to gnuradio4-blocks when mature.

config ENABLE_GR4_CONTROL_PLANE
    bool "gr4-control-plane (REST API server)"
    depends on ENABLE_GR4_CORE
    select ENABLE_HTTP
    help
        REST API server for remote flowgraph control, block introspection,
        and dynamic reconfiguration.

config CUSTOM_EP_ENABLE
    bool "Add a custom ExternalProject repo"
    default n
    help
        Add your own git repo as an ExternalProject alongside the standard
        gnuradio4 repos. Fill in name, URL, tag, and deps below.
        After configure, the repo is fetched and built on cmake --build.

if CUSTOM_EP_ENABLE

config CUSTOM_EP_NAME
    string "Repo name"
    default "my-blocks"
    help
        Short name used as the CMake target and checkout directory.

config CUSTOM_EP_URL
    string "Git URL"
    default ""
    help
        Full git clone URL, e.g. https://github.com/user/repo.git

config CUSTOM_EP_TAG
    string "Git ref (tag/branch/commit)"
    default "main"

config CUSTOM_EP_DEPENDS
    string "Dependencies (space-separated target names)"
    default "gnuradio4-core"
    help
        CMake target names this repo depends on, e.g.
        "gnuradio4-core gnuradio4-algorithm"

endif
endmenu

menu "Repository sources"
    depends on ENABLE_GR4_CORE

config GR4_CORE_REPO_URL
    string "gnuradio4-core git URL"
    default "https://github.com/gretel/gnuradio4-core.git"
    help
        Full git clone URL for the gnuradio4-core repo.
        Default points to gretel fork with Windows/MinGW patches.

config GR4_CORE_GIT_TAG
    string "gnuradio4-core git ref"
    default "main"
    help
        Git ref (branch/tag/commit) for gnuradio4-core.

config GR4_LIBRARY_REPO_URL
    string "gnuradio4-library git URL"
    default "https://github.com/gretel/gnuradio4-library.git"
    help
        Full git clone URL for the gnuradio4-library (algorithm) repo.
        Default points to gretel fork.

config GR4_LIBRARY_GIT_TAG
    string "gnuradio4-library git ref"
    default "main"

config GR4_BLOCKS_REPO_URL
    string "gnuradio4-blocks git URL"
    default "https://github.com/gretel/gnuradio4-blocks.git"
    help
        Full git clone URL for the gnuradio4-blocks repo.
        Default points to gretel fork.

config GR4_BLOCKS_GIT_TAG
    string "gnuradio4-blocks git ref"
    default "main"

config GR4_INCUBATOR_REPO_URL
    string "gr4-incubator git URL"
    default "https://github.com/gnuradio/gr4-incubator.git"
    help
        Full git clone URL for the gr4-incubator repo.

config GR4_INCUBATOR_GIT_TAG
    string "gr4-incubator git ref"
    default "main"

config GR4_CONTROL_PLANE_REPO_URL
    string "gr4-control-plane git URL"
    default "https://github.com/gnuradio/gnuradio4-control-plane.git"
    help
        Full git clone URL for the gr4-control-plane repo.

config GR4_CONTROL_PLANE_GIT_TAG
    string "gr4-control-plane git ref"
    default "main"

endmenu

menu "Features"
    depends on ENABLE_GR4_CORE

config ENABLE_SBOM
    bool "SPDX SBOM generation (cmake --install)"
    default y
    help
        Generates an SPDX 2.3 Software Bill of Materials (SBOM) during
        cmake --install via CMake-SBOM-Builder (sodgeit/CMake-SBOM-Builder).
        The SBOM lists installed SDK files and enabled runtime dependencies.

config ENABLE_HTTP
    bool "HTTP / REST API support"
    default y
    help
        Adds cpp-httplib dependency for HTTP integration tests, HTTP blocks,
        and the control-plane server. Required by control-plane and incubator
        (they select this automatically). Not needed for sdk/ci profiles.

config ENABLE_BLOCK_REGISTRY
    bool "Block registry (runtime introspection)"
    default y
    help
        Enables a runtime registry of blocks. Turning this off gives fully
        static builds. Generates JSON block metadata at build time.
        Required by plugin system and Python bindings.

config ENABLE_BLOCK_PLUGINS
    bool "Shared library block plugins"
    depends on ENABLE_BLOCK_REGISTRY
    default n
    help
        Load blocks from .dylib / .so at runtime via the plugin system.
        Requires block registry to generate the plugin metadata.

config ENABLE_TBB
    bool "Intel TBB parallelism"
    default n
    help
        Enables the TBB dependency for std::execution::par parallel policies.
        Gives better performance on multi-core CPUs but adds a dependency.

config ENABLE_PYTHON
    bool "Python bindings (pybind11 / NumPy)"
    default n
    help
        Builds Python bindings via pybind11 for runtime and block
        introspection from Python scripts and Jupyter notebooks.

config ENABLE_AUDIO
    bool "Audio I/O blocks (libsoundio)"
    default n
    help
        Build the audio block family (AudioSource / AudioSink) via libsoundio.
        Requires libsoundio development package with cmake or pkg-config support.
        Passed as GR4_ENABLE_AUDIO to gnuradio4-blocks.
        If enabled and libsoundio is not found, configuration fails with a
        clear error message.

config ENABLE_SDR
    bool "SDR block family (SoapySDR)"
    default n
    help
        Build the SDR block family (SoapySDR-based sources/sinks).
        Requires SoapySDR development package at build time.
        Passed as GR4_ENABLE_SDR to gnuradio4-blocks.

config ENABLE_MIT_ONLY
    bool "Exclude non-MIT/Apache-2.0 licensed modules"
    default n
    help
        Exclude modules with non-MIT/Apache-compatible licences.
        Drops GPL/LGPL-only blocks from the build.
endmenu

menu "Build"

config ENABLE_TESTING
    bool "gnuradio4 test suite (qa_*, ~100 targets)"
    default y
    help
        Enable the GNU Radio 4 test suite (qa_* targets).
        Passed to gnuradio4-core, gnuradio4-algorithm, and gnuradio4-blocks.



config ENABLE_EXAMPLES
    bool "Build examples"
    default y
    help
        Build example programs from gnuradio4-core and gnuradio4-blocks.

config ENABLE_COVERAGE
    bool "Code coverage (-coverage)"
    depends on ENABLE_TESTING
    default n
    help
        Enable code coverage instrumentation for the core test suite.
        Requires ENABLE_TESTING. Passed as ENABLE_COVERAGE to
        gnuradio4-core.

config WARNINGS_AS_ERRORS
    bool "-Werror (warnings as errors)"
    default y
    help
        Treats all compiler warnings as errors (-Werror). Passed as
        WARNINGS_AS_ERRORS to gnuradio4-core and gr4-incubator.

config TIMETRACE
    bool "Clang -ftime-trace (per-TU timings)"
    default n
    help
        Activates Clang's -ftime-trace for per-file compilation timing.
        Generates .json trace files for each translation unit.
        View with Chrome DevTools or Speedscope. Only works with Clang.

choice
    prompt "Caching"
    default CACHE_CCACHE

config CACHE_NONE
    bool "None"

config CACHE_CCACHE
    bool "ccache"

config CACHE_SCCACHE
    bool "sccache"
endchoice

config BUILD_JOBS
    int "Parallel compile jobs (0 = all cores)"
    range 0 64
    default 4

choice
    prompt "Sanitizer"
    default SANITIZER_NONE

config SANITIZER_NONE
    bool "None"

config SANITIZER_ADDRESS
    bool "AddressSanitizer"
    help
        Enables AddressSanitizer. Cannot be combined with other sanitizer
        options. Catches buffer overflows, use-after-free, and other memory
        bugs at runtime.

config SANITIZER_UB
    bool "UndefinedBehaviorSanitizer"
    help
        Enables UndefinedBehaviorSanitizer. Checks for signed overflow,
        misaligned access, null pointer arithmetic, and similar UB.

config SANITIZER_THREAD
    bool "ThreadSanitizer"
    help
        Enables ThreadSanitizer for data race detection. Strong impact on
        performance. Catches race conditions in multi-threaded code.
endchoice

menu "Reproducibility"
config GIT_ABBREV_LEN
	int "Git abbreviated hash length"
	range 4 40
	default 12
	help
	    Pinned abbreviation length for git commit hashes embedded in
	    version information. The default --short varies with the number
	    of git objects (full vs shallow clones produce different
	    lengths), breaking reproducible builds. Setting a fixed value
	    (default 12) ensures the same commit always produces the same
	    abbreviated hash string.

config REPRODUCIBLE_RPATH
	bool "Reproducible RPATH (CMAKE_BUILD_RPATH_USE_ORIGIN)"
	default y
	help
	    Use relative RPATH entries via $ORIGIN instead of absolute
	    build-directory paths. Makes installed binaries relocatable
	    and removes build-machine-specific paths from the output.
	    Trade-off: run-from-build-dir may need LD_LIBRARY_PATH if
	    CMAKE_SKIP_RPATH is also on (not the default here).

config CXX_EXTENSIONS
	bool "Enable compiler language extensions (gnu++23)"
	default n
	help
	    By default, the project compiles in standard C++23 mode
	    (c++23). Enabling this switches to gnu++23, which allows
	    compiler-specific extensions (typeof, __int128 builtins,
	    etc.). Keep OFF for maximum portability; enable only if a
	    sub-project or toolchain requires GNU extensions.
endmenu
endmenu

menu "Diagnostics"
depends on ENABLE_GR4_CORE

config ENABLE_DIAGNOSTICS
	bool "CMake diagnostics (CMake >= 4.4)"
	default n
	help
	    Enable CMake's built-in diagnostic categories (cmake-diagnostics(7))
	    for identifying potential issues in the build configuration.
	    Requires CMake >= 4.4; silently ignored on older versions.
	    Categories: policy, deprecated, uninitialized, author, unused CLI
	    options. The dev CMake preset enables these interactively.

if ENABLE_DIAGNOSTICS

config DIAG_ERROR_POLICY
	bool "Promote CMD_POLICY to errors"
	default n
	help
	    Treat CMake policy deprecation warnings as errors. Helps catch
	    use of deprecated APIs during CI.

config DIAG_WARN_DEPRECATED
	bool "Warn on deprecated CMake commands"
	default y
	help
	    Emit warnings when CMake commands or variables that have been
	    deprecated in the current CMake version are used.

config DIAG_WARN_UNINITIALIZED
	bool "Warn on uninitialized variables"
	default y
	help
	    Emit warnings when CMake encounters reference to variables
	    that have not been defined. Helps catch typos in variable names.

config DIAG_WARN_UNUSED_CLI
	bool "Warn on unused CLI variables"
	default n
	help
	    Emit warnings when -D variables on the command line are not
	    used during configuration. Helps catch misspelled cache vars.

endif
endmenu

menu "Instrumentation"
depends on ENABLE_GR4_CORE

config ENABLE_INSTRUMENTATION
	bool "Build instrumentation (CMake >= 4.3, Ninja only)"
	default n
	help
	    Enable CMake's instrumentation API (cmake-instrumentation(7))
	    for collecting timing data, target information, and system
	    diagnostics during configure, build, and test steps.
	    Generates Google Trace files viewable in chrome://tracing.
	    Requires CMake >= 4.3; emits a WARNING on older versions.
	    Only available with Makefile/Ninja generators.

if ENABLE_INSTRUMENTATION

config INSTR_HOOK
	string "Instrumentation hook"
	default "postCMakeBuild"
	help
	    When to collect instrumentation data. One of: postCMakeBuild,
	    postCMakeInstall, postCTest, or none. Default postCMakeBuild
	    runs after every cmake --build.

config INSTR_TRACE
	bool "Google Trace file (chrome://tracing)"
	default y
	help
	    Generate a Google Trace Event Format file during indexing.
	    Visualize build timeline in Chrome DevTools (chrome://tracing)
	    or Speedscope. Requires the CMD_TRACE option in CMake >= 4.3.

config INSTR_COMPILE_TRACE
	bool "Capture Clang -ftime-trace per-TU JSON (CMake >= 4.4)"
	depends on TIMETRACE
	default n
	help
	    Copy Clang -ftime-trace JSON files into the instrumentation
	    data directory. Requires both TIMETRACE (for the compiler flag)
	    and INSTRUMENTATION with compileTrace option (CMake >= 4.4).
	    This supersedes the standalone TIMETRACE bool for CI use;
	    standalone TIMETRACE remains for ad-hoc per-TU profiling.

config INSTR_CAPTURE_OUTPUT
	bool "Capture stdout/stderr per compile/link/test (CMake >= 4.4)"
	default n
	help
	    Capture standard output and error streams for each compile, link,
	    custom command, test, and install step. Useful for debugging but
	    increases instrumentation data volume. Requires CMake >= 4.4.

endif
endmenu

menu "Dependencies"
config USE_FETCHCONTENT
    bool "FetchContent for missing deps"
    default y
    help
        Allow CMake to download selected third-party dependencies (kiss_fft,
        fmt, Boost.UT, etc.) via FetchContent when not found on the system.
        In CI, enables automatic dependency resolution for test-only deps.
        Passed as GR_USE_FETCHCONTENT_DEPS to all sub-projects.

config USE_SYSTEM_DEPS
    bool "Require system packages only"
    default n
    help
        Fail configure if any dependency is not installed system-wide.
        Disables FetchContent fallback. Forces all dependencies to be
        pre-installed on the system.
endmenu
```

## configs/full_defconfig
```kconfig
CONFIG_ENABLE_GR4_CORE=y
CONFIG_ENABLE_GR4_INCUBATOR=n
CONFIG_ENABLE_GR4_CONTROL_PLANE=y
# CONFIG_ENABLE_HTTP auto-selected by CONTROL_PLANE
CONFIG_ENABLE_BLOCK_REGISTRY=y
CONFIG_ENABLE_BLOCK_PLUGINS=y
CONFIG_ENABLE_TBB=n
CONFIG_ENABLE_PYTHON=n
CONFIG_ENABLE_AUDIO=n
CONFIG_ENABLE_SDR=y
CONFIG_ENABLE_MIT_ONLY=n
CONFIG_ENABLE_TESTING=y
CONFIG_ENABLE_EXAMPLES=y
CONFIG_ENABLE_COVERAGE=n
CONFIG_WARNINGS_AS_ERRORS=y
CONFIG_TIMETRACE=n
CONFIG_CACHE_CCACHE=y
CONFIG_BUILD_JOBS=4
CONFIG_SANITIZER_NONE=y
CONFIG_USE_FETCHCONTENT=y
CONFIG_USE_SYSTEM_DEPS=n
```

## configs/sdk_defconfig
```kconfig
CONFIG_ENABLE_GR4_CORE=y
CONFIG_ENABLE_GR4_INCUBATOR=n
CONFIG_ENABLE_GR4_CONTROL_PLANE=n
CONFIG_ENABLE_HTTP=n
CONFIG_ENABLE_BLOCK_REGISTRY=n
CONFIG_ENABLE_BLOCK_PLUGINS=n
CONFIG_ENABLE_TBB=n
CONFIG_ENABLE_PYTHON=n
CONFIG_ENABLE_AUDIO=n
CONFIG_ENABLE_MIT_ONLY=n
CONFIG_ENABLE_TESTING=n
CONFIG_ENABLE_EXAMPLES=n
CONFIG_ENABLE_COVERAGE=n
CONFIG_WARNINGS_AS_ERRORS=n
CONFIG_TIMETRACE=n
CONFIG_CACHE_CCACHE=y
CONFIG_BUILD_JOBS=4
CONFIG_SANITIZER_NONE=y
CONFIG_USE_FETCHCONTENT=y
CONFIG_USE_SYSTEM_DEPS=n
# Reproducibility (new symbols in Build > Reproducibility)
CONFIG_GIT_ABBREV_LEN=12
CONFIG_REPRODUCIBLE_RPATH=y
CONFIG_CXX_EXTENSIONS=n
# Diagnostics (CMake >= 4.4)
CONFIG_ENABLE_DIAGNOSTICS=n
# Instrumentation (CMake >= 4.3)
CONFIG_ENABLE_INSTRUMENTATION=n
```
